## meta-ldd/conf/layer.conf
```bitbake
# We have a conf directory, add it to BBPATH
BBPATH .= ":${LAYERDIR}"

# Add recipes directories to BBFILES
BBFILES += "${LAYERDIR}/recipes-*/*/*.bb \
            ${LAYERDIR}/recipes-*/*/*.bbappend"

BBFILE_COLLECTIONS += "meta-ldd"
BBFILE_PATTERN_meta-ldd = "^${LAYERDIR}/"
BBFILE_PRIORITY_meta-ldd = "6"

LAYERDEPENDS_meta-ldd = "core"
LAYERSERIES_COMPAT_meta-ldd = "hardknott kirkstone"
```
